## Kconfig
```kconfig
mainmenu "EverythingNet/$(ARCH) $(APP_VERSION) Configuration"

source "app/Kconfig"
source "plat/Kconfig"
```

## app/Kconfig
```kconfig
menu "Application Settings"

config FOO
	bool
	help
	  Some Kconfig shit here
endmenu
```

## plat/Kconfig
```kconfig
config PLAT_SUPPORTS_HOST
	bool
	default n

config PLAT_SUPPORTS_DISPLAY
	bool
	default n

config PLAT_SUPPORTS_SOUND
	bool
	default n

config PLAT_SUPPORTS_INPUT
	bool
	default n

config PLAT_SUPPORTS_REL_INPUT
	bool
	default n

config PLAT_SUPPORTS_ABS_INPUT
	bool
	default n

choice
	prompt "Platform selection"
	default PLAT_LINUX
	help
	  Selects the desired platform to build EverythingNet for.

	config PLAT_LINUX
		bool "Linux"
		select PLAT_SUPPORTS_HOST
		select PLAT_SUPPORTS_DISPLAY
		select PLAT_SUPPORTS_SOUND
		select PLAT_SUPPORTS_INPUT
		select PLAT_SUPPORTS_REL_INPUT
		select PLAT_SUPPORTS_ABS_INPUT
		select PLAT_POSIX_LIKE
		help
		  Build for targetting a GNU/Linux system.  Can be cross
		  compiled like normal, or natively compiled if your host
		  is also Linux.

	if (ARCH=x86 || ARCH=x86_64 || ARCH=arm64 || ARCH=arm)
	config PLAT_WINDOWS
		bool "Microsoft Windows"
		select PLAT_SUPPORTS_HOST
		select PLAT_SUPPORTS_DISPLAY
		select PLAT_SUPPORTS_SOUND
		select PLAT_SUPPORTS_INPUT
		select PLAT_SUPPORTS_REL_INPUT
		select PLAT_SUPPORTS_ABS_INPUT
		help
		  Build for Microsoft Windows, using MINGW.  Building
		  via Visual Studio / MSVC is not supported.  Building
		  natively on Windows using MSYS2, Cygwin, or similar,
		  is not tested, but may work.  Can be built using
		  MINGW GCC or Clang (you will need to pass --target
		  manually for the latter).
	endif

	if ARCH=x86
	config PLAT_DOS
		bool "MS-DOS or compatible (FreeDOS, PC-DOS, DR-DOS, etc)"
		select PLAT_SUPPORTS_DISPLAY
		select PLAT_SUPPORTS_SOUND
		select PLAT_SUPPORTS_INPUT
		select PLAT_SUPPORTS_REL_INPUT
		select PLAT_SUPPORTS_ABS_INPUT
		help
		  Support running on MS-DOS or compatible operating systems.
		  Sound playback requires a SoundBlaster 16 or compatible
		  sound card.  Runs on any system with at least 640K of memory.
		  More memory may be required for complex arrangements of
		  multiple application windows.  Requires networking driver
		  to be installed to function. Runs on any 386 or later CPU.
		  Requires a CGA, EGA, or VGA or compatible graphics adapter
		  for graphics output beyond the text-mode startup banner.
	endif

	if ARCH=powerpc
	config PLAT_GCN
		bool "Nintendo GameCube (with libogc)"
		select NINTENDO_PPC_COMMON
		select PLAT_SUPPORTS_DISPLAY
		select PLAT_SUPPORTS_SOUND
		select PLAT_SUPPORTS_INPUT
		select PLAT_SUPPORTS_REL_INPUT
		help
		  Build targetting the Nintendo GameCube, using libogc.  It
		  will output both an ELF, and a DOL, suitable for booting via
		  any homebrew loader, such as Swiss.  EverythingNet requires
		  the Nintendo GameCube Broadband Adapter (DOL-015) to be
		  present in order for EverythingNet function correctly.
	config PLAT_WII
		bool "Nintendo Wii (with libogc)"
		select NINTENDO_PPC_COMMON
		select PLAT_SUPPORTS_DISPLAY
		select PLAT_SUPPORTS_SOUND
		select PLAT_SUPPORTS_INPUT
		select PLAT_SUPPORTS_REL_INPUT
		select PLAT_SUPPORTS_ABS_INPUT
		help
		  Build targetting the Nintendo Wii, using libogc.  It will
		  output both an ELF, and a DOL, suitable for booting via
		  the Homebrew Channel.  An internet connection, either
		  Wireless or Wired, must be set up via the connection
		  settings on the Wii Menu in order for EverythingNet to
		  function correctly.

		  EverythingNet can also be run via the standard Linux build,
		  targetting PowerPC, under Wii-Linux.  It will run much worse
		  under Linux due to the lack of video acceleration.
	config PLAT_WIIU
		bool "Nintendo Wii U (with wut)"
		#select PPC32
		select PLAT_SUPPORTS_DISPLAY
		select PLAT_SUPPORTS_SOUND
		select PLAT_SUPPORTS_INPUT
		select PLAT_SUPPORTS_REL_INPUT
		select PLAT_SUPPORTS_ABS_INPUT

	config PLAT_PS3
		bool "Sony PlayStation 3 (with PSL1GHT)"
		#select PPC64
		select PLAT_SUPPORTS_DISPLAY
		select PLAT_SUPPORTS_SOUND
		select PLAT_SUPPORTS_INPUT
		select PLAT_SUPPORTS_REL_INPUT
	endif

	if ARCH=arm64
	config PLAT_SWITCH
		bool "Nintendo Switch (with libnx)"
		select PLAT_SUPPORTS_DISPLAY
		select PLAT_SUPPORTS_SOUND
		select PLAT_SUPPORTS_INPUT
		select PLAT_SUPPORTS_REL_INPUT
		select PLAT_SUPPORTS_ABS_INPUT
		select PLAT_NEEDS_FLUSH_OUTPUT
		help
		  Build EverythingNet targetting the Nintendo Switch running
		  Horizon OS, using libnx.  An internet connection must be
		  set up in the system settings on the HOME Menu in order
		  for EverythingNet to function properly.

		  EverythingNet should also work targetting Linux or Android
		  on the Nintendo Switch, via L4S/Linux 4 Switch, as well as
		  LineageOS, respectively.
	endif

endchoice

menu "Common platform configuration"
source "plat/common/Kconfig"
endmenu

menu "Platform-specific configuration"

# traditional platforms
source "plat/linux/Kconfig"
source "plat/windows/Kconfig"
source "plat/dos/Kconfig"

# game consoles
## Nintendo
source "plat/nintendo-ppc-common/Kconfig"
source "plat/gcn/Kconfig"
source "plat/wii/Kconfig"
source "plat/wiiu/Kconfig"
source "plat/switch/Kconfig"

## Sony
source "plat/ps3/Kconfig"

endmenu
```

## plat/common/Kconfig
```kconfig
config PLAT_POSIX_TIMERS
	bool
	default n

config PLAT_POSIX_NET
	bool
	default n

config PLAT_POSIX_LIKE
	bool
	select PLAT_POSIX_TIMERS
	select PLAT_POSIX_NET
	default n

config PLAT_HAS_GLX
	bool
	default n

config PLAT_HAS_X11
	bool
	default n

config PLAT_HAS_WAYLAND
	bool
	default n

config PLAT_HAS_DRM
	bool
	default n

config PLAT_HAS_FBDEV
	bool
	default n

config PLAT_NEEDS_INTERNAL_LIBC
	bool
	default n
	select PLAT_NEEDS_INTERNAL_PRINTF

config PLAT_NEEDS_INTERNAL_PRINTF
	bool
	default n

config PLAT_NEEDS_FAKE_64BIT_MATH
	bool
	default n

config PLAT_NEEDS_FLUSH_OUTPUT
	bool
	default n

config PLAT_CAN_HAVE_MULTIPLE_INTERFACES
	bool
	default n

config PLAT_SUPPORTS_MULTICAST
	bool
	default n

config C_STD
	string "C Standard version"
	default "gnu89"
	default "gnu99" if PLAT_NINTENDO_PPC_COMMON
	default "gnu99" if PLAT_SWITCH
	help
	  The version of the C standard to compile as.
	  EverythingNet is designed to be compatible down to
	  ANSI C89, though some platforms may require higher
	  standards, either due to the platform's own headers
	  (such is the case for GameCube and Wii w/ libogc),
	  or due to functionality that EverythingNet depends on
	  (such is the case for Linux).

	  The default value should be the minimum required standard
	  for your platform, however you may adjust this as you
	  see fit.

config GFX_NEEDS_LIBGL
	bool
	default n

config GFX_NEEDS_LIBX11
	bool
	default n

config GFX_GLX
	bool "Xorg/GLX graphics support"
	default y
	depends on PLAT_HAS_X11
	depends on PLAT_HAS_OPENGL
	select GFX_NEEDS_LIBGL
	select GFX_NEEDS_LIBX11

config GFX_RAW_XORG
	bool "Direct Xorg/Xlib graphics support"
	default y
	depends on PLAT_HAS_X11
	select GFX_NEEDS_LIBX11

config GFX_WAYLAND
	bool "Wayland/EGL graphics support"
	default y
	depends on PLAT_HAS_WAYLAND

config GFX_DRM
	bool "DRM/KMS graphics support"
	default y
	depends on PLAT_HAS_DRM

config GFX_FB
	bool "Framebuffer graphics support"
	default y
	depends on PLAT_HAS_FBDEV

config NET_MAX_INT
	int "Maximum allowed network interfaces"
	default 8 if PLAT_CAN_HAVE_MULTIPLE_INTERFACES
	default 1 if !PLAT_CAN_HAVE_MULTIPLE_INTERFACES
	range 1 32767 if PLAT_CAN_HAVE_MULTIPLE_INTERFACES
	range 1 1 if !PLAT_CAN_HAVE_MULTIPLE_INTERFACES

config NET_MAX_PKT_KB
	int "Maximum packet size in kilobytes"
	default 64
	help
	  This is the maximum size of packet that can be recieved.
	  If a packet is recieved that is larger than this, it will
	  be truncated to fit.

	  EverythingNet will allocate this much memory during startup,
	  so do be careful what you set here if you have a constrained device.
```

## plat/dos/Kconfig
```kconfig
config SB16
	bool "SoundBlaster 16 or compatible sound support"
	default y
	depends on PLAT_DOS
```

## plat/nintendo-ppc-common/Kconfig
```kconfig
config NINTENDO_PPC_COMMON
	bool
	default n
	select PLAT_POSIX_TIMERS
	#select PPC32
	#select PLAT_NEEDS_INTERNAL_PRINTF
```
